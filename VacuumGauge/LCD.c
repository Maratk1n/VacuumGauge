#include "LCD.h"


// Cyrillic font
static uint8_t Cyrillic[0x100] =
{
	0x00,0x01,0x02,0x03,0x04,0x05,0x06,0x07,0x00,0x09,0x0A,0x0B,0x0C,0x0D,0x0E,0x0F,  // 0  15
	0x10,0x11,0x12,0x13,0x14,0x15,0xFF,0x7E,0xD9,0xDA,0x1A,0x1B,0x1C,0x1D,0x1E,0x1F,  // 1  31

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	0x70,0x63,0xBF,0x79,0xE4,0x78,0xE5,0xC0,0xC1,0xE6,0xC2,0xC3,0xC4,0xC5,0xC6,0xC7   // F  255
};

// User font
static uint8_t User[0x40] =
{
	0x00,0x00,0x0E,0x00,0x00,0x00,0x00,0x00,	// минус
	0x01,0x03,0x05,0x01,0x01,0x01,0x00,0x00,	// 1
	//	0x0E,0x1B,0x11,0x11,0x11,0x1F,0x1F,0x00,	// battery 20%
	0x06,0x09,0x01,0x02,0x04,0x0F,0x00,0x00,	// 2
	0x0F,0x01,0x02,0x07,0x01,0x0F,0x00,0x00,	// 3
	//	0x0E,0x1B,0x1F,0x1F,0x1F,0x1F,0x1F,0x00,	// battery 80%
	0x01,0x09,0x09,0x09,0x07,0x01,0x00,0x00,	// 4
	0x0F,0x08,0x0E,0x01,0x01,0x0E,0x00,0x00,	// 5
	0x00,0x04,0x0E,0x04,0x00,0x00,0x00,0x00,	// +
	0x04,0x04,0x0E,0x1F,0x00,0x15,0x15,0x00		// flag
};

void LCD_busy_flag_check()
{
	_delay_us(40);
}

void LCD_command_write(uint8_t DB)
{
	PORTG &= ~_BV(0);
	PORTC = DB;
	PORTG |= _BV(1);
	__nop();
	PORTG &= ~_BV(1);
	PORTC = 0;
}

void LCD_data_write(uint8_t DB)
{
	PORTG |= _BV(0);	// RS signal
	PORTC = DB;
	PORTG |= _BV(1);    // E strobe
	__nop();
	PORTG &= ~_BV(1);    // E strobe
	PORTC = 0;
	PORTG &= ~_BV(0);    // RS signal
}

void LCD_init()
{
	_delay_ms(15);
	LCD_command_write(0x30);
	_delay_ms(5);
	LCD_command_write(0x30);
	_delay_ms(2);
	LCD_command_write(0x30);
	_delay_ms(2);
	LCD_command_write(0x38);
	_delay_us(40);
	LCD_command_write(0xC);
	_delay_us(40);
	LCD_command_write(0x40);
	_delay_us(40);
	
	for(uint8_t i = 0; i < 0x40; i++){
		LCD_data_write(User[i]);
		_delay_us(40);
	}

	LCD_command_write(0x1);
	_delay_ms(2);
}

void LCD_text_out(uint8_t const* topline, uint8_t const* botline)
{
	LCD_busy_flag_check();
	LCD_command_write(0x80);
	uint8_t eol = 0;
	for(uint8_t i = 0; i < 16; i++)
	{
		LCD_busy_flag_check();
		if (!*topline)
		eol = 1;
		if (!eol)
		LCD_data_write(Cyrillic[*topline++]);
		else
		LCD_data_write(32);
	}
	LCD_busy_flag_check();
	LCD_command_write(0xC0);
	eol = 0;
	for(uint8_t i = 0; i < 16; i++)
	{
		LCD_busy_flag_check();
		if (!*botline)
		eol = 1;
		if (!eol)
		LCD_data_write(Cyrillic[*botline++]);
		else
		LCD_data_write(32);
	}
}

void LCD_masked_text(uint8_t const* topline, uint8_t const* botline, uint16_t topmask, uint16_t botmask)
{
	LCD_busy_flag_check();
	LCD_command_write(0x80);
	uint8_t eol = 0;
	for(uint8_t i = 0; i < 16; i++)
	{
		LCD_busy_flag_check();
		if (!*topline)
			eol = 1;
		if (eol||(topmask&_BV(i)))
			LCD_data_write(32);
		else
			LCD_data_write(Cyrillic[*topline]);
		topline++;
	}
	LCD_busy_flag_check();
	LCD_command_write(0xC0);
	eol = 0;
	for(uint8_t i = 0; i < 16; i++)
	{
		LCD_busy_flag_check();
		if (!*botline)
			eol = 1;
		if (eol||(botmask&_BV(i)))
			LCD_data_write(32);
		else
			LCD_data_write(Cyrillic[*botline]);
		botline++;
	}
}

void Display(void *t, void *b, uint16_t tmsk, uint16_t bmsk)
{
	LCD_masked_text(t, b,tmsk ,bmsk);
}